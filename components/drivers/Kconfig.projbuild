## components/drivers/Kconfig.projbuild
```kconfig
menu "SDCard Configuration"

config SDIO_DAT2_DISABLED
    bool "Disable the DAT2 in SDIO slave"
    default y
    help
        SDIO slave DAT pin is unfortunately the same pin as MTDI, which
        controls the flash power voltage. For 3.3v flash devkits / modules /
        kits, it conflicts with the DAT2 pullups required by the
        specification.

        This disables the peripheral input from the DAT2 so that we can work
        in 1-bit mode when DAT2 is floating (pulled down). 4-bit mode is
        therefore unavailable.

endmenu

menu "Hardware configuration"

choice EMULATOR_HARDWARE
	prompt "Hardware to run on"
	default ESPLAY_MICRO_HW
	help
		This emulator can run on various types of hardware. Select what you have here.

config ESPLAY20_HW
	bool "ESPlay 2.0 Hardware"

config ESPLAY_MICRO_HW
	bool "ESPlay Micro Hardware"

config HW_CUSTOM
	bool "Custom hardware"

endchoice

endmenu
```
